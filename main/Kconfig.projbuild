## main/Kconfig.projbuild
```kconfig
menu "Minuteman Config"

    config BLINK_GPIO
        int "Blink GPIO number"
        range 0 34
        default 5
        help
            GPIO number (IOxx) to blink on and off.

            Some GPIOs are used for other purposes (flash connections, etc.) and cannot be used to blink.

            GPIOs 35-39 are input-only so cannot be used as outputs.

    config PIN_NUM_MOSI
        int "GPIO number of MOSI"
        default 13 if IDF_TARGET_ESP8266
        default 19 if IDF_TARGET_ESP32 || IDF_TARGET_ESP32S2 || IDF_TARGET_ESP32S3 || IDF_TARGET_ESP32C3
        help
            GPIO number of MOSI

    config PIN_NUM_CLK
        int "GPIO number of CLK"
        default 14 if IDF_TARGET_ESP8266
        default 18 if IDF_TARGET_ESP32 || IDF_TARGET_ESP32S2 || IDF_TARGET_ESP32S3 || IDF_TARGET_ESP32C3
        help
            GPIO number of CLK

    config PIN_NUM_CS
        int "GPIO number of CS"
        default 15 if IDF_TARGET_ESP8266
        default 5 if IDF_TARGET_ESP32 || IDF_TARGET_ESP32S2 || IDF_TARGET_ESP32S3 || IDF_TARGET_ESP32C3
        help
            GPIO number of CS

    config PIN_ROT_ENCODER_A
        int "GPIO pin A for rotary encoder input."
        range 0 35
        default 34 

    config PIN_ROT_ENCODER_B
        int "GPIO pin B for rotary encoder input."
        range 0 35
        default 35 

    config PIN_ROT_ENCODER_BUTTON
        int "GPIO pin for rotary encoder button input."
        range 0 35
        default 32 

    config RE_EV_QUEUE_LEN
        int "Event queue length for rotary encoder events"
        default 5 

endmenu
```
